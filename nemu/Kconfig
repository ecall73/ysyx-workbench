## nemu/Kconfig
```kconfig
mainmenu "NEMU Configuration Menu"

choice
  prompt "Base ISA"
  default ISA_riscv
config ISA_x86
  bool "x86"
config ISA_mips32
  bool "mips32"
config ISA_riscv
  bool "riscv"
config ISA_loongarch32r
  bool "loongarch32r"
endchoice

config ISA
  string
  default "x86" if ISA_x86
  default "mips32" if ISA_mips32
  default "riscv32" if ISA_riscv && !RV64
  default "riscv64" if ISA_riscv &&  RV64
  default "loongarch32r" if ISA_loongarch32r
  default "none"

config ISA64
  depends on ISA_riscv && RV64
  bool
  default y


if ISA_riscv
source "src/isa/riscv32/Kconfig"
endif

choice
  prompt "NEMU execution engine"
  default ENGINE_INTERPRETER

config ENGINE_INTERPRETER
  bool "Interpreter"
  help
    Interpreter guest instructions one by one.
endchoice

config ENGINE
  string
  default "interpreter" if ENGINE_INTERPRETER
  default "none"

choice
  prompt "Running mode"
  default MODE_SYSTEM

config MODE_SYSTEM
  bool "System mode"
  help
    Support full-system functionality, including privileged instructions, MMU and devices.
endchoice

choice
  prompt "Build target"
  default TARGET_NATIVE_ELF
config TARGET_NATIVE_ELF
  bool "Executable on Linux Native"
config TARGET_SHARE
  bool "Shared object (used as REF for differential testing)"
config TARGET_AM
  bool "Application on Abstract-Machine (DON'T CHOOSE)"
endchoice

menu "Build Options"
choice
  prompt "Compiler"
  default CC_GCC
config CC_GCC
  bool "gcc"
config CC_GPP
  bool "g++"
config CC_CLANG
  depends on !TARGET_AM
  bool "clang"
endchoice

config CC
  string
  default "gcc" if CC_GCC
  default "g++" if CC_GPP
  default "clang" if CC_CLANG
  default "none"

choice
  prompt "Optimization Level"
  default CC_O2
config CC_O0
  bool "O0"
config CC_O1
  bool "O1"
config CC_O2
  bool "O2"
config CC_O3
  bool "O3"
endchoice

config CC_OPT
  string
  default "-O0" if CC_O0
  default "-O1" if CC_O1
  default "-O2" if CC_O2
  default "-O3" if CC_O3
  default "none"

config CC_LTO
  depends on !TARGET_AM
  bool "Enable link-time optimization"
  default n

config CC_DEBUG
  bool "Enable debug information"
  default n

config CC_ASAN
  depends on MODE_SYSTEM
  bool "Enable address sanitizer"
  default n
endmenu

menu "Testing and Debugging"


config TRACE
  bool "Enable tracer"
  default y

config TRACE_START
  depends on TRACE
  int "When tracing is enabled (unit: number of instructions)"
  default 0

config TRACE_END
  depends on TRACE
  int "When tracing is disabled (unit: number of instructions)"
  default 10000

config ITRACE
  depends on TRACE && TARGET_NATIVE_ELF && ENGINE_INTERPRETER
  bool "Enable instruction tracer"
  default y

config ITRACE_COND
  depends on ITRACE
  string "Only trace instructions when the condition is true"
  default "true"

config FTRACE
  depends on TRACE && TARGET_NATIVE_ELF && ENGINE_INTERPRETER
  bool "Enable function tracer (ftrace)"
  default n

config MTRACE
  depends on TRACE
  bool "Enable memory tracer (mtrace)"
  default n

config MTRACE_COND
  depends on MTRACE
  string "Only trace memory access when the condition is true"
  default "true"

config DTRACE
  depends on TRACE
  bool "Enable device trace (dtrace)"
  default n

config ETRACE
  depends on TRACE
  bool "Enable exception trace (etrace)"
  default n

if ISA_riscv
menuconfig RISCV_EXCEPTION_PANIC
  bool "Panic on selected RISC-V exceptions"
  depends on !TARGET_SHARE
  default n
  help
    Stop simulation after constructing a selected exception instead of
    delivering it to the architectural trap handler. Reference-library builds
    always disable this debugging policy.

if RISCV_EXCEPTION_PANIC
config EXCEPTION_PANIC_CAUSE_1_INSTRUCTION_ACCESS_FAULT
  bool "1: Instruction access fault"
  default y

config EXCEPTION_PANIC_CAUSE_2_ILLEGAL_INSTRUCTION
  bool "2: Illegal instruction"
  default y

config EXCEPTION_PANIC_CAUSE_4_LOAD_ADDRESS_MISALIGNED
  bool "4: Load address misaligned"
  default y

config EXCEPTION_PANIC_CAUSE_5_LOAD_ACCESS_FAULT
  bool "5: Load access fault"
  default y

config EXCEPTION_PANIC_CAUSE_6_STORE_AMO_ADDRESS_MISALIGNED
  bool "6: Store/AMO address misaligned"
  default y

config EXCEPTION_PANIC_CAUSE_7_STORE_AMO_ACCESS_FAULT
  bool "7: Store/AMO access fault"
  default y

config EXCEPTION_PANIC_CAUSE_8_ECALL_FROM_U_MODE
  bool "8: Environment call from U-mode"
  default n

config EXCEPTION_PANIC_CAUSE_9_ECALL_FROM_S_MODE
  bool "9: Environment call from S-mode"
  default n

config EXCEPTION_PANIC_CAUSE_11_ECALL_FROM_M_MODE
  bool "11: Environment call from M-mode"
  default n

config EXCEPTION_PANIC_CAUSE_12_INSTRUCTION_PAGE_FAULT
  bool "12: Instruction page fault"
  default y

config EXCEPTION_PANIC_CAUSE_13_LOAD_PAGE_FAULT
  bool "13: Load page fault"
  default y

config EXCEPTION_PANIC_CAUSE_15_STORE_AMO_PAGE_FAULT
  bool "15: Store/AMO page fault"
  default y
endif
endif


config DIFFTEST
  depends on TARGET_NATIVE_ELF
  bool "Enable differential testing"
  default n
  help
    Enable differential testing with a reference design.
    Note that this will significantly reduce the performance of NEMU.

choice
  prompt "Reference design"
  default DIFFTEST_REF_SPIKE if ISA_riscv
  default DIFFTEST_REF_KVM if ISA_x86
  default DIFFTEST_REF_QEMU
  depends on DIFFTEST
config DIFFTEST_REF_QEMU
  bool "QEMU, communicate with socket"
if ISA_riscv
config DIFFTEST_REF_SPIKE
  bool "Spike"
endif
if ISA_x86
config DIFFTEST_REF_KVM
  bool "KVM"
endif
endchoice

config DIFFTEST_REF_PATH
  string
  default "tools/qemu-diff" if DIFFTEST_REF_QEMU
  default "tools/kvm-diff" if DIFFTEST_REF_KVM
  default "tools/spike-diff" if DIFFTEST_REF_SPIKE
  default "none"

config DIFFTEST_REF_NAME
  string
  default "qemu" if DIFFTEST_REF_QEMU
  default "kvm" if DIFFTEST_REF_KVM
  default "spike" if DIFFTEST_REF_SPIKE
  default "none"

config WATCHPOINT
  bool "Enable watchpoint"
  default y
  help
    Enable watchpoint to monitor the change of expressions.
    Note that this will significantly reduce the performance of NEMU.

endmenu

if MODE_SYSTEM
source "src/memory/Kconfig"
source "src/device/Kconfig"
endif


menu "Miscellaneous"
choice
  depends on !TARGET_AM
  prompt "Host timer"
  default TIMER_GETTIMEOFDAY
config TIMER_GETTIMEOFDAY
  bool "gettimeofday"
config TIMER_CLOCK_GETTIME
  bool "clock_gettime"
endchoice

config RT_CHECK
  bool "Enable runtime checking"
  default y

endmenu
```

## nemu/configs/riscv32-host_defconfig
```kconfig
CONFIG_TRACE=y
CONFIG_ITRACE=y
CONFIG_CC_DEBUG=y
CONFIG_DIFFTEST=n
CONFIG_DEVICE=y
CONFIG_HAS_SERIAL=y
CONFIG_HAS_TIMER=y
CONFIG_HAS_KEYBOARD=y
CONFIG_HAS_VGA=y
CONFIG_VGA_SHOW_SCREEN=y
CONFIG_VGA_SIZE_400x300=y
```

## npc/Kconfig
```kconfig
mainmenu "NPC Configuration Menu"

choice
  prompt "Simulation platform"
  default PLATFORM_YSYXSOC
config PLATFORM_NPC
  bool "Standalone NPC"
config PLATFORM_YSYXSOC
  bool "NPC in ysyxSoC"
endchoice

config PLATFORM
  string
  default "npc" if PLATFORM_NPC
  default "ysyxsoc" if PLATFORM_YSYXSOC

menu "Build Options"
choice
  prompt "Verilator optimization level"
  default VERILATOR_O3
config VERILATOR_O0
  bool "O0"
config VERILATOR_O1
  bool "O1"
config VERILATOR_O2
  bool "O2"
config VERILATOR_O3
  bool "O3"
endchoice

config VERILATOR_OPT
  string
  default "-O0" if VERILATOR_O0
  default "-O1" if VERILATOR_O1
  default "-O2" if VERILATOR_O2
  default "-O3" if VERILATOR_O3

config DEBUG
  bool "Enable host debug information"
  default n

config MAX_SIM_TIME
  int "Maximum simulation cycles"
  default 1000000000
endmenu

menu "Testing and Debugging"
config TRACE
  bool "Enable trace infrastructure"
  default y

config TRACE_START
  int "Trace start instruction count"
  depends on TRACE
  default 0

config TRACE_END
  int "Trace end instruction count"
  depends on TRACE
  default 100000

config ITRACE
  bool "Enable instruction trace"
  depends on TRACE
  default n

config ITRACE_COND
  string "Instruction trace condition"
  depends on ITRACE
  default "true"

config FTRACE
  bool "Enable function trace"
  depends on TRACE
  default n

config MTRACE
  bool "Enable memory trace"
  depends on TRACE
  default n

config MTRACE_COND
  string "Memory trace condition"
  depends on MTRACE
  default "true"

config DTRACE
  bool "Enable device trace"
  depends on TRACE
  default n

config ETRACE
  bool "Enable exception trace"
  depends on TRACE
  default n

config DIFFTEST
  bool "Enable differential testing"
  default n

config WAVE
  bool "Enable waveform"
  default n

config PERF
  bool "Enable performance counters"
  default n
endmenu
```

## npc/configs/npc_defconfig
```kconfig
CONFIG_PLATFORM_NPC=y
CONFIG_TRACE=y
CONFIG_ITRACE=y
CONFIG_WATCHPOINT=y
CONFIG_PMEM_GARRAY=y
```
